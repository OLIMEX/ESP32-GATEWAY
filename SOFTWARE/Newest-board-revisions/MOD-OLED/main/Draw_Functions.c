#include "Draw_Functions.h"

const uint8_t font_16x16[][32] =
{
	{0x00, 0x00, 0x00, 0x00, 0x00, 0x00, 0x00, 0x00, 0x00, 0x00, 0x00, 0x00, 0x00, 0x00, 0x00, 0x00, 0x00, 0x00, 0x00, 0x00, 0x00, 0x00, 0x00, 0x00, 0x00, 0x00, 0x00, 0x00, 0x00, 0x00, 0x00, 0x00}, //  <Space>
	{0x00, 0x00, 0x00, 0x00, 0x07, 0x00, 0x0F, 0x80, 0x0F, 0x80, 0x0F, 0x80, 0x0F, 0x80, 0x0F, 0x80, 0x07, 0x00, 0x07, 0x00, 0x00, 0x00, 0x00, 0x00, 0x07, 0x00, 0x07, 0x00, 0x07, 0x00, 0x00, 0x00}, // !
	{0x00, 0x00, 0x0E, 0x38, 0x0E, 0x38, 0x0E, 0x38, 0x0E, 0x38, 0x06, 0x30, 0x00, 0x00, 0x00, 0x00, 0x00, 0x00, 0x00, 0x00, 0x00, 0x00, 0x00, 0x00, 0x00, 0x00, 0x00, 0x00, 0x00, 0x00, 0x00, 0x00},  // "
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	{0x00, 0x00, 0x00, 0x00, 0x1F, 0x1C, 0x3B, 0x9C, 0x39, 0xDC, 0x38, 0xF8, 0x00, 0x00, 0x00, 0x00, 0x00, 0x00, 0x00, 0x00, 0x00, 0x00, 0x00, 0x00, 0x00, 0x00, 0x00, 0x00, 0x00, 0x00, 0x00, 0x00},  // ~
};

const unsigned char font_6x8 [][5] =
{
	{ 0x00, 0x00, 0x00, 0x00, 0x00}, // sp
	{ 0x00, 0x00, 0x2f, 0x00, 0x00}, // !
	{ 0x00, 0x07, 0x00, 0x07, 0x00}, // "
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	{ 0x7E, 0x7E, 0x7E, 0x7E, 0x7E}, // square
};

void drawPixel (unsigned char x, unsigned char y)
{
	x -= 1;
	y -= 1;

	// check for out off range
	if (x >= LCD_X_RES)
		return;
	if (y >= LCD_Y_RES)
		return;

	//oledBuffer[ (y/8)*LCD_X_RES + x] |= 1<< (y%8);
	oledBuffer[ ( (y>>3)<<7) + x] |= 1<< (y&7);
}

void print_text (uint8_t row, char *text)
{
	uint8_t offset = 0;
	int counter = 0;
	
	if (row < 1)
		row = 1;
	row -= 1;
	if (row <= (LCD_Y_RES/16 - 1))
	{	
		while (*text != 0)
		{
			if (counter < 8)
			{
				uint16_t data[16];
				uint16_t temp[16];
				for (int i = 0; i < 16; i++)
				{
					temp[i] = font_16x16[*text - 32][i*2] << 8 | font_16x16[*text - 32][i*2 +1];
				}
  
				for (int i = 0; i < 16; i++)
				{
					data[i] = 0;
					for (int j = 0; j < 16; j++)
					{
						data[i] |= !! (temp[j] & (1 << (15-i))) << j;
					}
				}
				for (int i = 0; i < 16; i++)
				{
					oledBuffer[ (row*2 * LCD_X_RES) + i + offset] = data[i] & 0xFF;
					oledBuffer[ ( (row*2 + 1) * LCD_X_RES) + i + offset] = data[i] >> 8;
				}
				counter++;
			}
			offset += 16;
			text++;
		}
	}
}

void print_smchar (unsigned char x, unsigned char y, unsigned char ch, bool scr)
{
	unsigned int index = 0;
	unsigned int i = 0;
	x -= 1;
	y -= 1;

	// check for out off range
	if (x > LCD_X_RES)
		return;
	if (y > LCD_Y_RES)
		return;

	if (!scr)
	{
		if (x * 6 > (LCD_X_RES - 6))
		{
			x = 0;
			y += 1;
		}
	}
	
	index = (unsigned int) x * 6  + (unsigned int) y * LCD_X_RES;

	for (i = 0; i < 6; i++)
	{
		if (i==5)
			oledBuffer[index++] = 0x00;
		else
			oledBuffer[index++] = font_6x8[ch - 32][i];
	}
}

//print small font text, input is row on LCD, text to print, should the text be scrollable (0/1)
void print_smtext (unsigned char row, const unsigned char *dataPtr, bool scr)
{
	unsigned char x = 1;		// variable for X coordinate

	//if (row < 0) row = 0;
	if (row <= (LCD_Y_RES/8 - 1))
	{
		while (*dataPtr)
		{		
			// loop to the end of string
			print_smchar (x, row, *dataPtr, scr);
			if (!scr)
			{
				if (x * 6 > (LCD_X_RES - 6))
				{
					x = 0;
					row += 1;
				}
			}
			x++;
			dataPtr++;
		}
	}
	return;
}

//draw a line
void drawLine (int x1, int y1, int x2, int y2)
{
	int dx, dy, sx, sy, err, e2;
	dx = abs (x2-x1);
	dy = abs (y2-y1);
	if (x1<x2)
		sx = 1;
	else
		sx = -1;
	if (y1<y2)
		sy = 1;
	else
		sy = -1;
	err = dx-dy;
	do
	{
		drawPixel (x1, y1);
		if ((x1 == x2) && (y1 == y2))
			break;
		e2 = 2*err;
		if (e2 > -dy)
		{
			err = err - dy;
			x1 = x1+sx;
		}
		if (e2 < dx)
		{
			err = err + dx;
			y1 = y1 + sy;
		}
	}
	while (1);
	return;
}

//draw a rectangle
void drawRectangle (int x1, int y1, int x2, int y2)
{
	drawLine (x1, y1, x1, y2);
	drawLine (x1, y1, x2, y1);
	drawLine (x2, y1, x2, y2);
	drawLine (x1, y2, x2, y2);
	return;
}

//draw a solid rectangle
void drawSolidRectangle (int x1, int y1, int x2, int y2)
{
	int i = 0;
	if (x2>x1)
		for (i=x1; i<=x2;i++)
			drawLine (i, y1, i, y2);
	else
		for (i=x2; i<=x1;i++)
			drawLine (i, y1, i, y2);
	return;
}

//function needed for drawing an ellipse
void Ellipse4Points (int CX, int CY, int X, int Y)
{
	drawPixel (CX+X, CY+Y);
	drawPixel (CX-X, CY+Y);
	drawPixel (CX-X, CY-Y);
	drawPixel (CX+X, CY-Y);
	return;
}

//draw an ellipse & fix radius if negative
void drawEllipse (int CX, int CY, int XRadius, int YRadius)
{
	int X, Y, XChange, YChange, EllipseError, TwoASquare, TwoBSquare, StoppingX, StoppingY;
	if (XRadius<0)
		XRadius=-XRadius;
	if (YRadius<0)
		YRadius=-YRadius;

	TwoASquare = 2 * XRadius*XRadius;
	TwoBSquare = 2 * YRadius*YRadius;
	X = XRadius;
	Y = 0;
	XChange = YRadius*YRadius * (1-2*XRadius);
	YChange = XRadius*XRadius;
	EllipseError = 0;
	StoppingX = TwoBSquare*XRadius;
	StoppingY = 0;

	while (StoppingX >= StoppingY)
	{
		// 1st set of points, y'> -1
		Ellipse4Points (CX, CY, X, Y);
		Y++;
		StoppingY = StoppingY + TwoASquare;
		EllipseError = EllipseError + YChange;
		YChange = YChange + TwoASquare;
		if ( (2*EllipseError + XChange) > 0)
		{
			X--;
			StoppingX = StoppingX - TwoBSquare;
			EllipseError = EllipseError + XChange;
			XChange = XChange + TwoBSquare;
		}
	}

	X = 0;
	Y = YRadius;
	XChange = YRadius*YRadius;
	YChange = XRadius*XRadius * (1-2*YRadius);
	EllipseError = 0;
	StoppingX = 0;
	StoppingY = TwoASquare * YRadius;

	while (StoppingX <= StoppingY)
	{
		// 2nd set of points, y'< -1
		Ellipse4Points (CX, CY, X, Y);
		X++;
		StoppingX = StoppingX + TwoBSquare;
		EllipseError = EllipseError + XChange;
		XChange = XChange + TwoBSquare;
		if ( (2*EllipseError + YChange) > 0)
		{
			Y--;
			StoppingY = StoppingY - TwoASquare;
			EllipseError = EllipseError + YChange;
			YChange = YChange + TwoASquare;
		}
	}
	return;
}

//draw a circle
void drawCircle (int x, int y, int r)
{
	drawEllipse (x, y, r, r);
	return;
}

//draw a triangle
void drawTriangle (int x1, int y1, int x2, int y2, int x3, int y3)
{
	drawLine (x1, y1, x2, y2);
	drawLine (x2, y2, x3, y3);
	drawLine (x3, y3, x1, y1);
	return;
}
