## SOFTWARE/Newest-board-revisions/ETH_PHY_demo/main/Kconfig.projbuild
```kconfig
menu "Example Configuration"

choice PHY_MODEL
    prompt "Ethernet PHY"
    default CONFIG_PHY_LAN8720
    help
        Select the PHY driver to use for the example.
        Note: 
        Olimex EVB REV B IoT Board use LAN8710
        and can use the same config from LAN8720
        so here is no change need. we use LAN8720 config
        as default.

config PHY_LAN8720
    bool "Microchip LAN8710 PHY"
    help
        Select this to use the Microchip LAN8720 / LAN8710  PHY

endchoice

config PHY_ADDRESS
    int "PHY Address (0-31)"
    default 0
    range 0 31
    help
        Select the PHY Address (0-31) for the hardware configuration and PHY model.
        Note:
        Olimex EVB REV B IoT Board use PHY Address 0 and is default

config PHY_USE_POWER_PIN
    bool "Use PHY Power (enable/disable) pin"
    default n
    help
        Use a GPIO "power pin" to power the PHY on/off during operation.
        Consult the example README for more details
        Olimex ESP32 EVB REV B IoT LAN8710 Board with CAN do not use this

config PHY_POWER_PIN
    int "PHY Power GPIO"
    default 17
    depends on PHY_USE_POWER_PIN
    help
        GPIO number to use for powering on/off the PHY.

config PHY_SMI_MDC_PIN
    int "SMI MDC Pin"
    default 23
    help
        GPIO number to use for SMI clock output MDC to PHY.
        Note:
        Olimex EVB REV B IoT Board use GPIO 23 as default 

config PHY_SMI_MDIO_PIN
    int "SMI MDIO Pin"
    default 18
    help
       GPIO number to use for SMI data pin MDIO to/from PHY.
       Note:
       Olimex EVB REV B IoT Board use GPIO 18 as default

endmenu
```

## SOFTWARE/Newest-board-revisions/toggle_relay/main/Kconfig.projbuild
```kconfig
menu "Example Configuration"

choice
    prompt  "Select board relay to use in the example"

config RELAY_1
    bool "Relay 1"
    help
		Use Relay 1 to switch in the example.

config RELAY_2
    bool "Relay 2"
    help
		Use Relay 2 to switch in the example.

endchoice

endmenu
```
